## nuttx/apps/examples/mpu60x0_i2c/Kconfig
```kconfig
#
# For a description of the syntax of this configuration file,
# see the file kconfig-language.txt in the NuttX tools repository.
#

config EXAMPLES_MPU60X0_I2C
	tristate "MPU60X0 I2C example"
	default n
	---help---
		Enable the MPU60X0 I2C example

if EXAMPLES_MPU60X0_I2C
endif
```

## nuttx/apps/examples/spl06_i2c/Kconfig
```kconfig
#
# For a description of the syntax of this configuration file,
# see the file kconfig-language.txt in the NuttX tools repository.
#

config EXAMPLES_SPL06_I2C
	tristate "SPL06 I2C example"
	default n
	---help---
		Enable the SPL I2C example

if EXAMPLES_SPL06_I2C
endif
```

## nuttx/apps/examples/uorbc_test/Kconfig
```kconfig
#
# For a description of the syntax of this configuration file,
# see the file kconfig-language.txt in the NuttX tools repository.
#

config EXAMPLES_UORBC_TEST
	tristate "UORBC TEST example"
	default n
	---help---
		Enable the UORBC TEST example

if EXAMPLES_UORBC_TEST
endif
```
